## src/target/Kconfig.grandstream
```kconfig
# Grandstream phone models
#
# When adding a new model, please include it also in the Kconfig.platform
# listing for automatic selection of the SoC type.  That is the kind of
# thing that other users can feel rather uncertain about.  Supposedly,
# not everyone opens devices before starting to use them ;-)
#

choice
	prompt "2. Grandstream phone models"
	depends on TARGET_GRANDSTREAM
	default TARGET_GRANDSTREAM_BT20x

config TARGET_GRANDSTREAM_BT10x
	bool "Budgetone 100, 101, 102"
	select PLATFORM_TIC54x
	help
	  Budgetone is the entry-level speaker phone from Grandstream.
	  The older models were numbered 10x, the newer ones are 20x.
	  These older models have one or two 10 Mbps ethernet jacks.

	  They look like simple phones, with no line selection facilities
	  beyond a simple flash button.  They do however have buttons for
	  conferences and call transfer and hold.

config TARGET_GRANDSTREAM_BT20x
	bool "Budgetone 200, 201"
	select PLATFORM_TIC55x
	help
	  Budgetone is the entry-level speaker phone from Grandstream.
	  The older models were numbered 10x, the newer ones are 20x.
	  These newer models have one or two 100 Mbps ethernet jacks.

	  Note that the models with KSZ8842 network chips are supported,
	  but older models with RTL8019 currently are not.

	  They look like simple phones, with no line selection facilities
	  beyond a simple flash button.  They do however have buttons for
	  conferences and call transfer and hold.

config TARGET_GRANDSTREAM_GXP1200
	bool "Grandstream GXP 1200"
	depends on UNIMPLEMENTED
	select PLATFORM_TIC55x
	select TARGET_GRANDSTREAM_GXP
	help
	  These platforms are very similar to Budgetone 200 devices.
	  The differences are different wiring and an undocumented
	  graphical LCD.  The displays offer superior interfacing
	  compared to the Budgetone's 7-segment displays, so expect
	  some forthcoming work in this area.

config TARGET_GRANDSTREAM_GXP2020
	bool "Grandstream GXP 2020"
	depends on UNIMPLEMENTED
	select PLATFORM_TIC55x
	select TARGET_GRANDSTREAM_GXP
	help
	  Note that the models with KSZ8842 network chips are supported,
	  but older models with RTL8019 currently are not.  This is at
	  least a concern for (some) GXP2020 models.

config TARGET_GRANDSTREAM_GXP_OTHER
	bool "Grandstream GXP series"
	help
	  The GXP series from Grandstream is very consistent in its
	  architecture.  If you are not afraid of a bit of probing
	  with an ohm-meter and minor editing of this code, then you
	  are probably capable of adding your favourite GXP phone to
	  this software.  And of course we will gladly integrate your
	  changes, so you don't have to keep your own code forked.

config TARGET_GRANDSTREAM_GXV
	bool "Grandstream GXV series (video phones)"
	select PLATFORM_TIC55X
	help
	  These platforms are more advancaed than Grandstream's GXP
	  platforms, and include various new hardware components that
	  are not currently supported:

	   * TIC6x DSP processor
	   * colour display
	   * camera
	   * touch screen (on some models)

	  Support for these models is not planned at this time.

endchoice
```

## src/target/Kconfig.meta
```kconfig
# Meta-configuration

menu "0. Configuration meta parameters"

config DEVEL
	bool "Show development build options"
	default n
	select FUNCTION_DEVEL_NETCONSOLE
	help
	  Aside from production builds, there are various intermediate
	  settings that are helpful while reverse engineering, testing
	  and debugging.  This option shows those additional builds.

	  A few examples of added facilities: very basic programs that
	  basic I/O (hook contact, LED, that sort of thing) without
	  assuming a network driver; network driver testing; and of
	  course debugging output to a platform's console interface.

	  Select this option if you are developing on the 0cpm firmerware.

config UNIMPLEMENTED
	bool "Include incomplete build options"
	depends on DEVEL
	default n
	help
	  This option selects platforms and options whose development
	  has not yet been completed.

	  Select this option while developing on such incomplete code.
	  It is possible to checkin such code as long as the Kconfig
	  options include "depends on UNIMPLEMENTED"

config PLATFORM_PREFIX
	string "Toolchain prefix directory"
	default ""

config PLATFORM_BIN_PATH
	string "Path to toolchain binaries"
	default "$PLATFORM_PREFIX/bin"

config PLATFORM_LIB_PATH
	string "Path to toolchain libraries"
	default "$PLATFORM_PREFIX/include"

config PLATFORM_INCLUDE_PATH
	string "Path to toolchain include files"
	default "$PLATFORM_PREFIX/include"

config NET_6BED4_SERVER
	string "6bed4 server IPv4 address"
	help
	  Specify the IPv4 address of the remote tunnel endpoint
	  that will unpack 6bed4 packages.  This is basically
	  IPv6 stateless autoconfiguration over an UDP-tunnel.

	  Details about 6bed4 can be found on:
	  http://devel.0cpm.org/6bed4/
	  This page should also help you to an IP-number; first,
	  experimental values but after RFC-acceptance there should
	  be an IANA-registered anycast address.

	  Work is underway for making this globally available on
	  an anycast-address.  Until that has been setup, there is
	  a need to specify an IPv4 address explicitly.

endmenu
```

## src/target/Kconfig.model
```kconfig
# Model selection (includes with a separate setup for each brand)

source "src/target/Kconfig.posix"
source "src/target/Kconfig.grandstream"
source "src/target/Kconfig.gigaset"
#TODO# source "src/target/Kconfig.fritzbox"
#TODO# source "src/target/Kconfig.sipura"
source "src/target/Kconfig.smc"
```

## src/target/Kconfig.platform
```kconfig
# Platform-specific settings (platforms are usually a SoC or CPU type)

choice
	prompt "3. Hardware platform (SoC/CPU/DSP class)"

config PLATFORM_LOCAL
	bool "Local POSIX system"
	depends on TARGET_POSIX

# Include all manufacturers / models in the "depends on" clause, connected with ||
config PLATFORM_TIC54x
	bool "tic54x"
	depends on TARGET_GRANDSTREAM_BT10x

# Include all manufacturers / models in the "depends on" clause, connected with ||
config PLATFORM_TIC55x
	bool "tic55x (READ HELP)"
	depends on TARGET_GRANDSTREAM_BT20x || TARGET_GRANDSTREAM_GXP1200 || TARGET_GRANDSTREAM_GXP2020
	help
	  **Please be careful**
	  The TIC55x platform is not supported by gcc or lvmm compilers.
	  You can download a toolchain at no expense from the TI website,
	  but this will not bring you the freedom that you need to comply
	  to the GPLv3 under which the 0cpm firmerware is released.
	  Please read the file src/driver/tic55x/LICENSE-WARNING.TXT about
	  the incompatibility problem between TI's toolchain license and
	  the open source license of the 0cpm firmerware.

# Include all manufacturers in the "depends on" clause, connected with ||
config PLATFORM_BLACKFIN
	bool "Analog Devices' Blackfin"
	depends on TARGET_IMAGINARY
	help
	  Blackfin DSPs are Analoge Devices' systems-on-chip, supported
	  with open source toolchains based on gcc.  They are said to
	  occur in various phones.  AD suggests the U-Boot bootloader,
	  making them accessible as candidates for new firmware like this.

endchoice
```

## src/target/Kconfig.posix
```kconfig
# POSIX-based target platforms

choice
	prompt "2. POSIX-based phone targets"
	depends on TARGET_POSIX
	default TARGET_LINUX_RAWSOCK

config TARGET_LINUX_RAWSOCK
	bool "Linux desktop"
	depends on UNIMPLEMENTED
	select TARGET_POSIX_RAWSOCK
	help
	  This is a platform intended to run on the same platform as
	  used for building.  It is built on a raw socket, so it does
	  not require IPv6 support in the kernel.  It will obtain its
	  own network leases, so it should be tested for non-interference
	  if any other software is run on the same platform.

	  Once built, run the command src/target/rawsock/firmly0cpm.bin
	  on your current platform.  It will configure itself automatically.

	  TODO: sound devices?  keyboard?  display?

	  TODO: Demo entry. Not implemented yet.

config TARGET_LINUX_TUNTEST
	bool "Linux tunnel device"
	depends on DEVEL
	help
	  Test and demonstration target intended for development.

	  This creates a tunnel interface behind which the firmly.0cpm
	  firmware is working.  You can route/bridge/filter/simulate
	  the surrounding network in any way you like.

	  Once built, run the command src/target/tuntest/firmly0cpm.bin
	  on your current platform.  It will configure itself automatically.

	  TODO: sound devices?  keyboard?  display?

endchoice
```

## src/target/Kconfig.smc
```kconfig
# SMC phone models -- quite a variety because they sell prototypes as products

choice
	prompt "2. SMC phone models"
	depends on TARGET_SMC
	default TARGET_SMC_DSP20x

config TARGET_SMC_DSP20x
	bool "SMC DSP200"
	select PLATFORM_CM5000LF
	help
	  The SMC DSP200 and DSP205 models are actually prototypes from
	  CrystalMedia, the fabless producer of the CM5000LF SoC in
	  these phones.  Strange as that may sound, the phones are
	  actually more powerful than quite a few others.

	  The firmware in the phones is notoriously hard to configure.
	  But it does include testing code, which allows for a lot of
	  control.  The 4-line serial interface runs at 57600 8N1 and
	  the pins are [3V3], TxD, RxD, GND.

	  After building the firmware image, it can be uploaded over
	  this serial link.  First, select ic.img by pressing Enter
	  over the link in the first 3 seconds after testing RAM.
	  Then use the Download User Program option.

	  Future versions of this firmware are probably going to
	  look as firmware updates: a gzipped fcodec.out, gzipped
	  ic.img and gzipped user program named voip.img, all
	  attached.  Finally, a CRC-32 checksum over all those,
	  appended as 8 uppercase hex characters.  Interestingly,
	  the GPL may require the rest to be recoded for that to
	  be distributable.

endchoice
```
