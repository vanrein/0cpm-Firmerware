## src/function/Kconfig
```kconfig
# Function for the target image

menu "4. Firmerware functions"

choice
	prompt "Primary firmware function"
	default MAINFUNCTION_SIP_PHONE

source "src/function/Kconfig.devel"

config MAINFUNCTION_SIP_PHONE
	bool "SIP phone over IPv6"
	select CODEC_G711 if !CODEC_CODEC2
	select CODEC_RTT
	select CODEC_ZRTP
	help
	  This is the customary primary function for the 0cpm firmerware.
          It implements SIP phone functionality over IPv6.  Included are
	  facilities to obtain IPv6 connectivity on all networks.

config MAINFUNCTION_SIP_DOORBELL
	bool "SIP doorbell over IPv6"
	help
	  This is an alternative primary function for the 0cpm firmerware.
	  It implements a doorbell that is switched off until a button
	  is pressed.  As soon as the device boots, it will dial out to
	  a predefined number on a predefined server.

	  This is not quite the same as a phone configured as a hotline.
	  Such a phone would always be switched on, even though normal
	  use would not include calling to the device.  So, to save
	  energy, the doorbell application assumes that a phone is
	  switched off when not in use.  The device will keep itself
	  switched on until it is done with its task.


config MAINFUNCTION_SIP_ALARMCLOCK
	bool "SIP alarm clock over IPv6"
	help
	  This is an alternate primary function for the 0cpm firmerware.
	  It implements an alarm clock that does not ring the phone,
	  but rather picks up immediately and plays whatever sound
	  is sent to it.  It is imagined that a network service would
	  wake up all those souls who have a hard time hearing a
	  rooster nearby.

	  TODO:
	  To further implement the logic of an alarm clock, use of the
	  hook contact will make it speak out the current time.  There
	  is a facility for a button that will set the alarm to go a
	  predefined number of hours after it was pressed.  You might
	  go as far as to wire that to your bed!


config MAINFUNCTION_BOOTLOADER
	bool "Bootloader"
	select FUNCTION_NETCONSOLE
	select FUNCTION_FIRMWARE_UPGRADES
	help
	  Some phones have less RAM than Flash on board.  On such phones,
	  stability improves with the installation of a small bootloader
	  that is smaller than RAM.  More in general, it helps to upgrade
	  the firmerware under tight local control.

	  The bootloader is initiated after a power cycle if (and as long as)
	  the horn is off-hook.  This is not usually the case, so normally
	  the bootloader is skipped quickly.

	  While the bootloader is active, all nonvolatile partitions are
	  made available over TFTP for reading and writing.  To aid in
	  automation, ...TODO...

	  The bootloader does not run over IPv6 or even IPv4; it is only
	  routed locally because it runs as a TFTP server directly on top
	  of 802.2 Ethernet (LLC type 1).  You will need a special TFTP
	  client to be able to access the bootloader.

	  Note that the bootloader code itself can also be replaced by
	  the bootloader.  Be very careful when doing that, as there
	  will be no warning for quite a few mistakes you could make.

endchoice

config FUNCTION_SOUND_PLAYER
	bool "Networked sound player device"
	help
	  Configure the phone as a networked sound device.  This enables
	  computers on the LAN to send sound to the phone to have it played.
	  This is only supported on an IPv6-enabled LAN.

	  The protocol to use is RTP/L16, which is a standard audio/video
	  codec intended for uncompressed sample data, just like you
	  would offer to a local sound card.

	  You can send such RTP Multicast streams with PulseAudio, using
	  the s16ne or s16be sample format.  For information on support of
	  PulseAudio in your software, see http://www.pulseaudio.org/

config FUNCTION_RADIO
	bool "Internet radio (multicast reception)"
	depends on UNIMPLEMENTED && !MAINFUNCTION_DEVEL_GPIO && !MAINFUNCTION_DEVEL_TIMER && !MAINFUNCTION_DEVEL_KEYBOARD && !MAINFUNCTION_DEVEL_NETWORK && !MAINFUNCTION_DEVEL_SOUND
	default y
	help
	  Enable Internet Radio functions.  This makes the phone pickup
	  stream announcements, and play one as selected by the user.
	  The radio function works over the speaker, and stop playing
	  during phone calls.  The radio volume can be set separately
	  from other volume settings.

	  This function is targeted at business networks, rewarding
	  them for supplying IPv6 Multicast on their LANs.  It is only
	  supported on LANs with native IPv6.  Any stream with a suitable
	  codec (like RTP/Vorbis) that is multicasted over IPv6/UDP/RTP
	  and announced with SAP can be played back by the phone.

	  You could consider finding a suitable radio station on m6bone,
	  and permitting that infrastructure to get to your LAN.  This
	  would only require you to broadcast the channel listing over
	  SAP every now and then.

	  Do not forget to select the codecs used for streaming the
	  content.

	  TODO - not implemented yet.

config FUNCTION_RADIO_CHANNELS
	int "Maximum number of channels to store"
	default 32
	help
	  The number of Internet Radio channels that are stored is
	  fixed.  You can specify a high enough upper limit to be
	  on the safe side.

config FUNCTION_NETCONSOLE
	bool "LAN-based console"
	depends on !MAINFUNCTION_DEVEL_GPIO && !MAINFUNCTION_DEVEL_TIMER && !MAINFUNCTION_DEVEL_KEYBOARD
	default y if DEVEL=n
	help
	  Direct console traffic for the main application to the network.

	  The protocol used for this network console is Logical Link Control
	  or IEEE 802.2, more to the point LLC2 which is a bit like TCP but
	  directly on top of Ethernet.  It is only accessible to directly
	  connected computers on the same LAN, so this is very suitable to
	  release console information to a LAN.

	  This console can be an add-on module for other targets, or it can
	  be selected as a development target to become the main function for
	  the image being built.  In that capacity it is a good test for the
	  network drivers.

	  This facility is normally only of use during development, but may
	  nonetheless be compiled into end-user modules.

config FUNCTION_FIRMWARE_UPGRADES
	bool "Support firmware upgrades"
	depends on !MAINFUNCTION_DEVEL_GPIO && !MAINFUNCTION_DEVEL_TIMER && !MAINFUNCTION_DEVEL_KEYBOARD && !MAINFUNCTION_DEVEL_SOUND
	default y if MAINFUNCTION_BOOTLOADER=y
	help
	  It is possible, though not strictly required, to support
	  the download and installation of new firmware.  As normal
	  IP addresses are used, this is not as safe as the upgrades
	  that are included in the dedicated bootloader main function.
	  TODO: Also use TFTP over LLC1?

	  If the upgrade fails, the phone will need to be upgraded
	  through the bootloader, if it has one.

	  Do not select this option without considering its implications.

config FUNCTION_FIRMWARE_UPGRADES_BOOTLOADER
	bool "Support bootloader upgrades (DANGEROUS)"
	depends on FUNCTION_FIRMWARE_UPGRADES
	default n
	help
	  This is a dangerous facility!

	  Complete remote control over a phone is only possible if all
	  firmware, including even its bootloader, can be upgraded from
	  a remote site.  This option enables that facility.

	  Note that this facility makes the phone rather vulnerable.
	  Anyone with access to the phone's TFTP service will be able
	  to upload new firmware to replace it.  You do want to have a
	  tightly controlled firewall to avoid this from being abused.

	  TODO: a polling TFTP client may in fact be better?

endmenu
```

## src/function/Kconfig.devel
```kconfig
# Development functions

config MAINFUNCTION_DEVEL_GPIO
	bool "Test switch / light"
	depends on DEVEL
	help
	  This is the simplest possible test program, which can be useful
	  to ensure control over a device during reverse engineering.

	  The application continuously scans the hook.  It makes the message
	  LED burn while the phone is off-hook.

	  Additional firmware functions will not work, as the kernel and
	  other support infrastructure is not incorporated into this test.

config MAINFUNCTION_DEVEL_TIMER
	bool "Test timer interrupts"
	depends on DEVEL
	help
	  This is a very simple test program.  It makes the message LED
	  flash with a 1 second period and a 50% duty cycle.  It can be
	  used to develop timer drivers.

	  Additional firmware functions will not work, as the kernel and
	  other support infrastructure is not incorporated into this test.

config MAINFUNCTION_DEVEL_KEYBOARD
	bool "Test keyboard / display"
	depends on DEVEL
	help
	  This test processes input from the keyboard, and shows it on
	  the display, as well as printing it to the platform's console,
	  if any.

	  Additional firmware functions will not work, as the kernel and
	  other support infrastructure is not incorporated into this test.

config MAINFUNCTION_DEVEL_NETWORK
	bool "Test network"
	depends on DEVEL
	select FUNCTION_NETCONSOLE
	help
	  This test runs a networked console.  The test will print information
	  about incoming network packets and ignore traffic sent to the device.

	  Note that the performance is not based on timers, but instead
	  triggered when something is logged.  This may lead to delays in the
	  delivery, of bursty sends that cause rejects at the LLC2 level.
	  This is really just a test, rather than a perfect application.

	  The details of the networked console are described under the
	  add-on function for this console, one menu level up.

	  Additional firmware functions will not work, as the kernel and
	  other support infrastructure is not incorporated into this test.

config MAINFUNCTION_DEVEL_SOUND
	bool "Test sound"
	depends on DEVEL
	select FUNCTION_DEVEL_SOUNDIO
	help
	  This test turns your phone into an echo well.  While off-hook, it will
	  echo handset voice to the handset with a one-second delay.  If it is
	  a speakerphone, it will use the built-in microphone and speaker to do
	  the same while on-hook.
          
	  The sound is usually best implemented through DMA.  Not only does this
	  save lots of interrupts while working on other things, but the reliance
	  on hardware timers and not on any software aspects helps to keep the
	  sample rate very stable, thus leading to better voice quality.

	  Additional firmware functions will not work, as the kernel and
	  other support infrastructure is not incorporated into this test.
```

## src/target/Kconfig
```kconfig
#
# Target configuration
#
# Targets are platforms on which one or more drivers can be
# configured to support various chips.  Order alphabetically
# by the manufacturer's name, then the model.
#
# Targets are selected by make and model.  Detailed selection
# of specific models (and, possibly, chips to drive) are made
# in submenus loaded from the target's own directory.
#


mainmenu "Configure 0cpm Firmerware for SIP telephony"

# 0. Meta configuration
source "src/target/Kconfig.meta"

# 1. Brand selection
source "src/target/Kconfig.brand"

# 2. Model within brand
source "src/target/Kconfig.model"

# 3. Hardware platform for model
source "src/target/Kconfig.platform"

# 4. Intended functionality
source "src/function/Kconfig"

source "src/net/Kconfig"
source "src/phone/Kconfig"
```

## src/target/Kconfig.brand
```kconfig
# Manufacturers / brands

choice
	prompt "1. Hardware manufacturer"
	default TARGET_GRANDSTREAM

config TARGET_GRANDSTREAM
	bool "Grandstream"
	help
	  Grandstream phones, shown on http://www.grandstream.com/
	  are built around Texas Instruments' DSP processor ranges
	  TMS320VC5401 and TMS320VC5501.  You would have to scratch
	  paint off of the DSP before being able to read that, but
	  given the model it is possible to establish the target.

	  Reverse engineering information is available on
	  http://devel.0cpm.org/reverse/grandstream/

config TARGET_POSIX
	bool "POSIX platforms"
	help
	  Not all firmware runs as a standalone image.  Several run
	  on top of POSIX-compliant platforms like Linux.
	  Select this target to include those platforms.

config TARGET_APPLE
	bool "Apple"
	depends on UNIMPLEMENTED
	help
	  The Apple platforms run on top of Darwin, their own brand of
	  FreeBSD.  This target sets up potential Apple targets.

config TARGET_SIPURA
	bool "Sipura/Linksys/Cisco SPA"
	depends on UNIMPLEMENTED
	help

config TARGET_FRITZBOX
	bool "AVM Fritz!Box"
	depends on UNIMPLEMENTED
	help
	  Depending on the model, AVM Fritz!Box can use any of a variety
	  of telephony chips.  The firmware will build a program that
	  can be incorporated into Freetz (see http://freetz.org/ for
	  details).

config TARGET_GIGASET
	bool "Siemens Gigaset xnnnIP"
	depends on UNIMPLEMENTED
	help
	  The Siemens Gigaset platform has DECT/SIP phones with numbers
	  like C470IP or A580IP.  Important in this is the "IP" postfix.
	  There has been a short-lived clone from Target, the DIP450.

	  The platforms contain LGPL-licensed software so they permit
	  uploading new firmware from their web interface.

	  Once built, upload src/target/gigaset/firmly0cpm.bin to a
	  webserver and set the firmware location in your phone to the
	  proper URL to migrate to the new platform.

	  TODO: Demo entry. Not implemented yet.

config TARGET_IMAGINARY
	bool "Imaginary phone targets"
	help
	  These target phones do not actually exist.  They are merely
	  used as placeholders for hardware that is likely to come to
	  life in some shape or form in the near future.  Do not build
	  targets based on this target without updating the build
	  structures in src/target/Kconfig* and src/target/Makefile*
	  to something more concrete.

	  TODO: Demo entry. Not likely to build.

endchoice
```

## src/target/Kconfig.gigaset
```kconfig
# Siemens/Gigaset phone models

choice
	prompt "2. Siemens Gigaset phone models"
	depends on TARGET_GIGASET
	default TARGET_GIGASET_A580IP

config TARGET_GIGASET_CHAGALL
	bool "Gigaset A580IP, C470IP, xxxIP"
	select PLATFORM_ARM
	select PLATFORM_ARM_BLUEBIRD
	help
	  Siemens Gigaset is a platform for DECT in general.  The models
	  that end in "IP" are the ones that implement SIP functionality.

endchoice
```
